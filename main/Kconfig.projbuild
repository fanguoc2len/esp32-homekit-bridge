## main/Kconfig.projbuild
```kconfig
menu "DoAn2 HomeKit Config"

config SMARTHOME_WIFI_SSID
    string "Wi-Fi SSID"
    default ""
    depends on SMARTHOME_WIFI_ONBOARDING_HARDCODED
    help
        Station SSID for the HomeKit firmware.

config SMARTHOME_WIFI_PASSWORD
    string "Wi-Fi password"
    default ""
    depends on SMARTHOME_WIFI_ONBOARDING_HARDCODED
    help
        Station password for the HomeKit firmware.

choice SMARTHOME_WIFI_ONBOARDING_MODE
    bool "Wi-Fi onboarding mode"
    default SMARTHOME_WIFI_ONBOARDING_PROVISIONING
    help
        Apple Home pairs only after the accessory is already on Wi-Fi.
        Use Unified Provisioning for first-boot onboarding, or hardcode
        credentials for bench testing.

    config SMARTHOME_WIFI_ONBOARDING_PROVISIONING
        bool "Unified Provisioning"

    config SMARTHOME_WIFI_ONBOARDING_HARDCODED
        bool "Hardcoded Wi-Fi credentials"
endchoice

choice SMARTHOME_WIFI_PROV_TRANSPORT
    bool "Provisioning transport"
    default SMARTHOME_WIFI_PROV_TRANSPORT_SOFTAP
    depends on SMARTHOME_WIFI_ONBOARDING_PROVISIONING
    help
        Choose how the phone provisions Wi-Fi credentials before Apple Home pairing.

    config SMARTHOME_WIFI_PROV_TRANSPORT_SOFTAP
        bool "SoftAP provisioning"

    config SMARTHOME_WIFI_PROV_TRANSPORT_BLE
        bool "BLE provisioning"
        depends on !IDF_TARGET_ESP32S2
        select BT_ENABLED
endchoice

config SMARTHOME_WIFI_PROV_SERVICE_PREFIX
    string "Provisioning service prefix"
    default "DOAN2_"
    depends on SMARTHOME_WIFI_ONBOARDING_PROVISIONING
    help
        Prefix used to build the provisioning service name shown to the phone app.

config SMARTHOME_WIFI_PROV_SHOW_QR
    bool "Show provisioning QR URL"
    default y
    depends on SMARTHOME_WIFI_ONBOARDING_PROVISIONING
    help
        Print the provisioning QR payload URL to the serial console.

config SMARTHOME_BRIDGE_NAME
    string "HomeKit bridge name"
    default "DoAn2 Bridge"

config SMARTHOME_MANUFACTURER
    string "Accessory manufacturer"
    default "DoAn2"

config SMARTHOME_BRIDGE_MODEL
    string "Bridge model"
    default "ESP32HomeKitBridge"

config SMARTHOME_SERIAL_NUMBER
    string "Bridge serial number prefix"
    default "DOAN2-ESP32"

config SMARTHOME_FW_REVISION
    string "Firmware revision"
    default "0.1.0"

config SMARTHOME_SWITCH_ID
    string "Primary switch logical ID"
    default "hk_switch_1"

config SMARTHOME_SWITCH_NAME
    string "Primary switch display name"
    default "Aux Switch"

config SMARTHOME_SWITCH_GPIO
    int "Primary switch GPIO"
    range 0 39
    default 26
    help
        Phase 2 sample GPIO switch. Keep this on a dedicated relay or test load pin.
        For a simple ESP32 LED demo, many dev boards use GPIO 2. For a NeoPixel
        demo, this becomes the data pin for the LED.

choice SMARTHOME_PRIMARY_OUTPUT_DRIVER
    bool "Primary output hardware driver"
    default SMARTHOME_PRIMARY_OUTPUT_DRIVER_GPIO
    help
        Select how the primary HomeKit output is driven on hardware.

    config SMARTHOME_PRIMARY_OUTPUT_DRIVER_GPIO
        bool "Plain GPIO on/off"

    config SMARTHOME_PRIMARY_OUTPUT_DRIVER_NEOPIXEL
        bool "NeoPixel / WS2812 RGB"
endchoice

config SMARTHOME_SWITCH_ACTIVE_HIGH
    bool "Primary switch is active high"
    default y

choice SMARTHOME_PRIMARY_OUTPUT_SERVICE
    bool "Primary output HomeKit service type"
    default SMARTHOME_PRIMARY_OUTPUT_SERVICE_LIGHT
    help
        Select how the primary hardware output is represented in Apple Home.

    config SMARTHOME_PRIMARY_OUTPUT_SERVICE_SWITCH
        bool "Switch"

    config SMARTHOME_PRIMARY_OUTPUT_SERVICE_LIGHT
        bool "Lightbulb"

    config SMARTHOME_PRIMARY_OUTPUT_SERVICE_FAN
        bool "Fan"

    config SMARTHOME_PRIMARY_OUTPUT_SERVICE_OUTLET
        bool "Outlet"
endchoice

config SMARTHOME_OUTPUT_BOOT_ON
    bool "Primary output boots ON"
    default n
    help
        Keep this disabled for the safest relay boot behavior unless the load
        must restore to ON before HomeKit connects.

config SMARTHOME_SWITCH_SYNC_INTERVAL_MS
    int "Hardware sync interval (ms)"
    range 100 5000
    default 250
    help
        Poll interval used to reflect local GPIO state back into HomeKit.

config SMARTHOME_LOCAL_STATE_SELF_TEST
    bool "Enable local state self-test"
    default n
    help
        Diagnostic only. Periodically toggles the primary output from firmware so
        you can verify the device-to-HomeKit sync path on real hardware.

config SMARTHOME_LOCAL_STATE_SELF_TEST_INTERVAL_MS
    int "Local state self-test interval (ms)"
    range 1000 60000
    default 10000
    depends on SMARTHOME_LOCAL_STATE_SELF_TEST
    help
        Delay between firmware-side toggles when the self-test is enabled.

menu "Virtual migration devices"

config SMARTHOME_ENABLE_VIRTUAL_LOCK
    bool "Expose a virtual HomeKit door lock"
    default y
    help
        Adds a Lock Mechanism accessory so the migration has a complete
        door/lock HomeKit path before a physical lock actuator is installed.

config SMARTHOME_LOCK_ID
    string "Virtual lock logical ID"
    default "front_door_lock"
    depends on SMARTHOME_ENABLE_VIRTUAL_LOCK

config SMARTHOME_LOCK_NAME
    string "Virtual lock display name"
    default "Front Door Lock"
    depends on SMARTHOME_ENABLE_VIRTUAL_LOCK

config SMARTHOME_LOCK_BOOT_LOCKED
    bool "Virtual lock boots secured"
    default y
    depends on SMARTHOME_ENABLE_VIRTUAL_LOCK

config SMARTHOME_ENABLE_ENV_SENSOR
    bool "Expose a virtual temperature/humidity sensor"
    default y
    help
        Adds HomeKit Temperature Sensor and Humidity Sensor services. This is
        a migration scaffold for a future DHT/SHT/BME driver and can simulate
        realistic values when hardware is not available.

config SMARTHOME_ENV_SENSOR_ID
    string "Environment sensor logical ID"
    default "environment_sensor"
    depends on SMARTHOME_ENABLE_ENV_SENSOR

config SMARTHOME_ENV_SENSOR_NAME
    string "Environment sensor display name"
    default "Room Climate"
    depends on SMARTHOME_ENABLE_ENV_SENSOR

config SMARTHOME_ENV_SENSOR_TEMPERATURE
    bool "Expose temperature service"
    default y
    depends on SMARTHOME_ENABLE_ENV_SENSOR

config SMARTHOME_ENV_TEMPERATURE_C_X10
    int "Initial temperature in Celsius x10"
    range -400 1000
    default 275
    depends on SMARTHOME_ENABLE_ENV_SENSOR && SMARTHOME_ENV_SENSOR_TEMPERATURE
    help
        Example: 275 means 27.5 degrees Celsius.

config SMARTHOME_ENV_SENSOR_HUMIDITY
    bool "Expose humidity service"
    default y
    depends on SMARTHOME_ENABLE_ENV_SENSOR

config SMARTHOME_ENV_HUMIDITY_PERCENT_X10
    int "Initial humidity percent x10"
    range 0 1000
    default 650
    depends on SMARTHOME_ENABLE_ENV_SENSOR && SMARTHOME_ENV_SENSOR_HUMIDITY
    help
        Example: 650 means 65.0 percent relative humidity.

config SMARTHOME_ENV_SENSOR_SIMULATOR
    bool "Simulate changing sensor readings"
    default y
    depends on SMARTHOME_ENABLE_ENV_SENSOR
    help
        Periodically nudges the virtual readings so HomeKit event updates can
        be tested without a physical sensor board.

config SMARTHOME_ENV_SENSOR_SIM_INTERVAL_MS
    int "Sensor simulator interval (ms)"
    range 5000 300000
    default 30000
    depends on SMARTHOME_ENV_SENSOR_SIMULATOR

endmenu

config SMARTHOME_HAP_SETUP_CODE
    string "HomeKit setup code"
    default "111-22-333"
    help
        Test setup code in xxx-xx-xxx format.

config SMARTHOME_HAP_SETUP_ID
    string "HomeKit setup ID"
    default "ES32"
    help
        Four-character setup ID for test builds.

endmenu
```

## sdkconfig.defaults
```kconfig
CONFIG_PARTITION_TABLE_CUSTOM=y
CONFIG_PARTITION_TABLE_CUSTOM_FILENAME="partitions_hap.csv"
CONFIG_LOG_DEFAULT_LEVEL_INFO=y
CONFIG_LWIP_MAX_SOCKETS=16
CONFIG_SMARTHOME_WIFI_SSID=""
CONFIG_SMARTHOME_WIFI_PASSWORD=""
CONFIG_SMARTHOME_WIFI_ONBOARDING_PROVISIONING=y
CONFIG_SMARTHOME_WIFI_PROV_TRANSPORT_SOFTAP=y
CONFIG_SMARTHOME_WIFI_PROV_SERVICE_PREFIX="DOAN2_"
CONFIG_SMARTHOME_WIFI_PROV_SHOW_QR=y
CONFIG_SMARTHOME_BRIDGE_NAME="DoAn2 Bridge"
CONFIG_SMARTHOME_MANUFACTURER="DoAn2"
CONFIG_SMARTHOME_BRIDGE_MODEL="ESP32HomeKitBridge"
CONFIG_SMARTHOME_SERIAL_NUMBER="DOAN2-ESP32"
CONFIG_SMARTHOME_FW_REVISION="0.1.0"
CONFIG_SMARTHOME_SWITCH_ID="hk_switch_1"
CONFIG_SMARTHOME_SWITCH_NAME="Aux Switch"
CONFIG_SMARTHOME_SWITCH_GPIO=26
CONFIG_SMARTHOME_SWITCH_ACTIVE_HIGH=y
CONFIG_SMARTHOME_PRIMARY_OUTPUT_SERVICE_LIGHT=y
CONFIG_SMARTHOME_OUTPUT_BOOT_ON=n
CONFIG_SMARTHOME_SWITCH_SYNC_INTERVAL_MS=250
CONFIG_SMARTHOME_LOCAL_STATE_SELF_TEST=n
CONFIG_SMARTHOME_LOCAL_STATE_SELF_TEST_INTERVAL_MS=10000
CONFIG_SMARTHOME_ENABLE_VIRTUAL_LOCK=y
CONFIG_SMARTHOME_LOCK_ID="front_door_lock"
CONFIG_SMARTHOME_LOCK_NAME="Front Door Lock"
CONFIG_SMARTHOME_LOCK_BOOT_LOCKED=y
CONFIG_SMARTHOME_ENABLE_ENV_SENSOR=y
CONFIG_SMARTHOME_ENV_SENSOR_ID="environment_sensor"
CONFIG_SMARTHOME_ENV_SENSOR_NAME="Room Climate"
CONFIG_SMARTHOME_ENV_SENSOR_TEMPERATURE=y
CONFIG_SMARTHOME_ENV_TEMPERATURE_C_X10=275
CONFIG_SMARTHOME_ENV_SENSOR_HUMIDITY=y
CONFIG_SMARTHOME_ENV_HUMIDITY_PERCENT_X10=650
CONFIG_SMARTHOME_ENV_SENSOR_SIMULATOR=y
CONFIG_SMARTHOME_ENV_SENSOR_SIM_INTERVAL_MS=30000
CONFIG_SMARTHOME_HAP_SETUP_CODE="111-22-333"
CONFIG_SMARTHOME_HAP_SETUP_ID="ES32"
```
